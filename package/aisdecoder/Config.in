## package/aisdecoder/Config.in
```kconfig
config BR2_PACKAGE_AISDECODER
	bool "aisdecoder"
	select BR2_PACKAGE_LIBRTLSDR
	select BR2_PACKAGE_ALSA_LIB
	help
	  A software AIS decoder.

	  http://www.aishub.net/
```

## package/ical2crontab/Config.in
```kconfig
config BR2_PACKAGE_ICAL2CRONTAB
     bool "ical2crontab"
     depends on BR2_PACKAGE_LIBICAL
     help
       This tool convert ical format into cron format.

       https://github.com/NicolasJourden/ical2crontab
```

## package/kalibrate-rtl/Config.in
```kconfig
config BR2_PACKAGE_KALIBRATE_RTL
	bool "kalibrate-rtl"
	depends on BR2_PACKAGE_LIBRTLSDR
	depends on BR2_PACKAGE_FFTW_PRECISION_DOUBLE
	help
	  A tool to calibrate rtl-sdr receiver.
```

## package/rtl-ais/Config.in
```kconfig
config BR2_PACKAGE_RTL_AIS
	bool "rtl-ais"
	select BR2_PACKAGE_LIBRTLSDR
	help
	  A software AIS decoder combined with RTL-SDR.

	  https://github.com/dgiardini/rtl-ais
```
